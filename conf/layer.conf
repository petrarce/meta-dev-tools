## conf/layer.conf
```bitbake
# We have a conf and classes directory, add to BBPATH
BBPATH .= ":${LAYERDIR}"

# We have recipes-* directories, add to BBFILES
BBFILES += "${LAYERDIR}/recipes-*/*/*.bb \
            ${LAYERDIR}/recipes-*/*/*.bbappend"

BBFILE_COLLECTIONS += "meta-dev-tools"
BBFILE_PATTERN_meta-dev-tools = "^${LAYERDIR}/"
BBFILE_PRIORITY_meta-dev-tools = "6"

LAYERDEPENDS_meta-dev-tools = "core"
LAYERSERIES_COMPAT_meta-dev-tools = "mickledore"
```
